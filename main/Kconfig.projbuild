## main/Kconfig.projbuild
```kconfig
menu "Pilot System Configuration"

    config PILOT_BLE_DEVICE_NAME
        string "BLE provisioning device name"
        default "ESP32S3_PILOT"

    config PILOT_FACTORY_PARTITION_NAME
        string "Factory NVS partition name"
        default "fct_data"

    config PILOT_FACTORY_NVS_NAMESPACE
        string "Factory NVS namespace"
        default "storage"

    config PILOT_FALLBACK_POP_CODE
        string "Fallback device password (compile-time, Security 2 / SRP6a)"
        default "CHANGE_ME_BEFORE_PRODUCTION"
        help
            SRP6a password (P). Called 'PoP' in ESP-IDF docs.
            Used only when factory NVS key "device_password" is absent.

    config PILOT_RESET_BUTTON_GPIO
        int "Factory reset button GPIO number"
        default 0
        range 0 48

    config PILOT_RESET_HOLD_TIME_MS
        int "Reset button hold time (ms)"
        default 10000
        range 3000 30000

    config PILOT_OTA_MAX_SIZE_BYTES
        int "Maximum accepted OTA firmware size (bytes)"
        default 2621440
        help
            Guard against oversized uploads. Default 2.5 MB matches ota_0/1.

    config PILOT_OTA_BUF_SIZE
        int "OTA receive buffer size (bytes, PSRAM)"
        default 32768
        range 4096 65536

    config PILOT_LOG_WS_QUEUE_DEPTH
        int "Log WebSocket queue depth"
        default 64
        range 16 256

    config PILOT_LOG_WS_MSG_MAX_LEN
        int "Max log message length over WebSocket"
        default 256
        range 64 512

    config PILOT_HTTPS_PORT
        int "HTTPS server port"
        default 443
        range 1 65535

    config PILOT_LITTLEFS_PARTITION_LABEL
        string "LittleFS partition label"
        default "littlefs"
        help
            Must match the label in partitions.csv.

    config PILOT_LITTLEFS_BASE_PATH
        string "LittleFS mount point"
        default "/www"
        help
            VFS mount point. Static files are served from this path.

endmenu
```

## sdkconfig.defaults
```kconfig
# ── Partition table ─────────────────────────────────────────────────────────
CONFIG_PARTITION_TABLE_CUSTOM=y
CONFIG_PARTITION_TABLE_CUSTOM_FILENAME="partitions.csv"

# ── Flash size ───────────────────────────────────────────────────────────────
CONFIG_ESPTOOLPY_FLASHSIZE_8MB=y
CONFIG_ESPTOOLPY_FLASHSIZE="8MB"

# ── PSRAM – ESP32-S3-WROOM-1U-N8R8 (OPI / Octal PSRAM) ─────────────────────
CONFIG_SPIRAM=y
CONFIG_SPIRAM_MODE_OCT=y
CONFIG_SPIRAM_SPEED_80M=y
CONFIG_SPIRAM_USE_MALLOC=y
CONFIG_SPIRAM_MALLOC_ALWAYSINTERNAL=16384

# ── HTTPS server ─────────────────────────────────────────────────────────────
CONFIG_ESP_HTTPS_SERVER_ENABLE=y

# ── WebSocket support ────────────────────────────────────────────────────────
CONFIG_HTTPD_WS_SUPPORT=y

# ESP-TLS
CONFIG_ESP_TLS_SERVER_SESSION_TICKETS=y

# ── TLS / mbedTLS – dynamic buffers for parallel connections ─────────────────
CONFIG_MBEDTLS_DYNAMIC_BUFFER=y
CONFIG_MBEDTLS_SSL_IN_CONTENT_LEN=16384
CONFIG_MBEDTLS_SSL_OUT_CONTENT_LEN=4096

# ── OTA ──────────────────────────────────────────────────────────────────────
CONFIG_ESP_HTTPS_OTA_ALLOW_HTTP=n

# ── Provisioning security (IDF 6.0: Security 0 and 1 disabled by default) ───
# We use Security 2 (SRP6a) only – no need to re-enable the weaker versions.

# ── LittleFS ─────────────────────────────────────────────────────────────────
CONFIG_LITTLEFS_MAX_PARTITIONS=1
CONFIG_LITTLEFS_PAGE_SIZE=256
CONFIG_LITTLEFS_OBJ_NAME_LEN=64

# ── IDF 6.0: Picolibc is the new default libc ────────────────────────────────
# No explicit override needed – Picolibc is fully compatible with our codebase.

# ── Logging ──────────────────────────────────────────────────────────────────
CONFIG_LOG_DEFAULT_LEVEL_INFO=y

#
# Bluetooth
#
CONFIG_BT_ENABLED=y
CONFIG_BT_NIMBLE_ENABLED=y
CONFIG_BT_CONTROLLER_ENABLED=y

# ── Task Watchdog (TWDT) – production hardening ─────────────────────────────
CONFIG_ESP_TASK_WDT_ENABLE=y
CONFIG_ESP_TASK_WDT_PANIC=y
```
